/*
 * Copyright (C) 2022 The Android Open Source Project
 *
 * Licensed under the Apache License, Version 2.0 (the "License");
 * you may not use this file except in compliance with the License.
 * You may obtain a copy of the License at
 *
 *      http://www.apache.org/licenses/LICENSE-2.0
 *
 * Unless required by applicable law or agreed to in writing, software
 * distributed under the License is distributed on an "AS IS" BASIS,
 * WITHOUT WARRANTIES OR CONDITIONS OF ANY KIND, either express or implied.
 * See the License for the specific language governing permissions and
 * limitations under the License.
 */

#include "dt-bindings/interrupt-controller/arm-gic.h"

/dts-v1/;
/ {
    compatible = "google,test_device";
    chosen {
        kaslr-seed = <0xcafed00d 0x12345678>;
        bootargs = "arg0=blah arg1=blah arg2=blah";
    };

    gic: interrupt-controller@DEADBEEF {
        compatible = "arm,gic-v3";
        reg = <0x0 0x12345678 0x10000>,
              <0x0 0x9ABCDEF0 0x10000>;
    };
};
